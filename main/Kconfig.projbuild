## main/Kconfig.projbuild
```kconfig
menu "Orbis panel"

    config APP_POLL_INTERVAL_S
        int "Home Assistant poll interval (seconds)"
        range 2 120
        default 5
        help
            How often each entity state is refreshed through the REST API when the
            WebSocket channel is not in use.

    config APP_WEB_ENABLED
        bool "Enable the on-device web configuration server"
        default n
        help
            Serves http://<device-ip>/ for editing WiFi / HA settings and uploading
            firmware. Disabled by default: it costs about 6-10 KB of internal RAM
            (httpd task stack + sockets), which this board cannot spare while the
            Bluetooth stack and the HA WebSocket are also linked in.
            With it disabled, changing WiFi/HA settings requires editing secrets.h
            and reflashing.

    config APP_VOICE_ENABLED
        bool "Enable the XiaoZhi voice assistant"
        default n
        help
            Builds and starts the XiaoZhi voice client (WebSocket to the voice server,
            Opus encode/decode, PDM microphone capture) and shows the white assistant
            page as the last page.
            Disabled by default: the audio path is still unstable on this board and a
            tap on the assistant page can reset the device. With it off the panel is a
            pure Home Assistant control screen and none of the voice code runs.

endmenu
```
